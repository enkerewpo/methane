// Generated by CIRCT firtool-1.48.0
// Standard header to adapt well known macros to our needs.
`ifndef RANDOMIZE
  `ifdef RANDOMIZE_REG_INIT
    `define RANDOMIZE
  `endif // RANDOMIZE_REG_INIT
`endif // not def RANDOMIZE

// RANDOM may be set to an expression that produces a 32-bit random unsigned value.
`ifndef RANDOM
  `define RANDOM $random
`endif // not def RANDOM

// Users can define INIT_RANDOM as general code that gets injected into the
// initializer block for modules with registers.
`ifndef INIT_RANDOM
  `define INIT_RANDOM
`endif // not def INIT_RANDOM

// If using random initialization, you can also define RANDOMIZE_DELAY to
// customize the delay used, otherwise 0.002 is used.
`ifndef RANDOMIZE_DELAY
  `define RANDOMIZE_DELAY 0.002
`endif // not def RANDOMIZE_DELAY

// Define INIT_RANDOM_PROLOG_ for use in our modules below.
`ifndef INIT_RANDOM_PROLOG_
  `ifdef RANDOMIZE
    `ifdef VERILATOR
      `define INIT_RANDOM_PROLOG_ `INIT_RANDOM
    `else  // VERILATOR
      `define INIT_RANDOM_PROLOG_ `INIT_RANDOM #`RANDOMIZE_DELAY begin end
    `endif // VERILATOR
  `else  // RANDOMIZE
    `define INIT_RANDOM_PROLOG_
  `endif // RANDOMIZE
`endif // not def INIT_RANDOM_PROLOG_

// Include register initializers in init blocks unless synthesis is set
`ifndef SYNTHESIS
  `ifndef ENABLE_INITIAL_REG_
    `define ENABLE_INITIAL_REG_
  `endif // not def ENABLE_INITIAL_REG_
`endif // not def SYNTHESIS

// Include rmemory initializers in init blocks unless synthesis is set
`ifndef SYNTHESIS
  `ifndef ENABLE_INITIAL_MEM_
    `define ENABLE_INITIAL_MEM_
  `endif // not def ENABLE_INITIAL_MEM_
`endif // not def SYNTHESIS

module ADSR(
  input         clock,
                reset,
                io_en,
                io_note_on,
                io_note_off,
  input  [15:0] io_attack,
                io_decay,
                io_sustain,
                io_release,
  output [15:0] io_out
);

  reg [2:0]  state;
  reg [15:0] counter;
  reg [15:0] out;
  reg [15:0] attack_slope;
  reg [15:0] decay_slope;
  reg [15:0] release_slope;
  always @(posedge clock) begin
    if (reset) begin
      state <= 3'h0;
      counter <= 16'h0;
      out <= 16'h0;
      attack_slope <= 16'h0;
      decay_slope <= 16'h0;
      release_slope <= 16'h0;
    end
    else begin
      automatic logic             _GEN;
      automatic logic             _GEN_0;
      automatic logic             _GEN_1;
      automatic logic             _GEN_2;
      automatic logic             _GEN_3;
      automatic logic [7:0][15:0] _GEN_4;
      _GEN = counter == io_attack;
      _GEN_0 = io_note_off | _GEN;
      _GEN_1 = counter == io_decay;
      _GEN_2 = io_note_off | _GEN_1;
      _GEN_3 = counter == io_release;
      if (state == 3'h0) begin
        if (io_note_on) begin
          state <= 3'h1;
          out <= 16'h0;
        end
      end
      else if (state == 3'h1) begin
        if (io_note_off)
          state <= 3'h4;
        else if (_GEN)
          state <= 3'h2;
        if (~_GEN_0)
          out <= out + attack_slope;
      end
      else if (state == 3'h2) begin
        if (io_note_off)
          state <= 3'h4;
        else if (_GEN_1)
          state <= 3'h3;
        if (~_GEN_2)
          out <= out - decay_slope;
      end
      else begin
        automatic logic _GEN_5;
        automatic logic _GEN_6;
        _GEN_5 = state == 3'h3;
        _GEN_6 = state == 3'h4;
        if (_GEN_5) begin
          if (io_note_off)
            state <= 3'h4;
        end
        else if (_GEN_6 & _GEN_3)
          state <= 3'h0;
        if (_GEN_5 | ~_GEN_6) begin
        end
        else if (_GEN_3)
          out <= 16'h0;
        else
          out <= out - release_slope;
      end
      _GEN_4 =
        {{counter},
         {counter},
         {counter},
         {_GEN_3 ? 16'h0 : counter + 16'h1},
         {io_note_off ? 16'h0 : counter},
         {_GEN_2 ? 16'h0 : counter + 16'h1},
         {_GEN_0 ? 16'h0 : counter + 16'h1},
         {io_note_on ? 16'h0 : counter}};
      counter <= _GEN_4[state];
      attack_slope <= 16'hFDE8 / io_attack;
      decay_slope <= (16'hFDE8 - io_sustain) / io_decay;
      release_slope <= io_sustain / io_release;
    end
  end // always @(posedge)
  `ifdef ENABLE_INITIAL_REG_
    `ifdef FIRRTL_BEFORE_INITIAL
      `FIRRTL_BEFORE_INITIAL
    `endif // FIRRTL_BEFORE_INITIAL
    initial begin
      automatic logic [31:0] _RANDOM[0:2];
      `ifdef INIT_RANDOM_PROLOG_
        `INIT_RANDOM_PROLOG_
      `endif // INIT_RANDOM_PROLOG_
      `ifdef RANDOMIZE_REG_INIT
        for (logic [1:0] i = 2'h0; i < 2'h3; i += 2'h1) begin
          _RANDOM[i] = `RANDOM;
        end
        state = _RANDOM[2'h0][2:0];
        counter = _RANDOM[2'h0][18:3];
        out = {_RANDOM[2'h0][31:19], _RANDOM[2'h1][2:0]};
        attack_slope = _RANDOM[2'h1][18:3];
        decay_slope = {_RANDOM[2'h1][31:19], _RANDOM[2'h2][2:0]};
        release_slope = _RANDOM[2'h2][18:3];
      `endif // RANDOMIZE_REG_INIT
    end // initial
    `ifdef FIRRTL_AFTER_INITIAL
      `FIRRTL_AFTER_INITIAL
    `endif // FIRRTL_AFTER_INITIAL
  `endif // ENABLE_INITIAL_REG_
  assign io_out = out;
endmodule

